## misc/buildroot/configs/sninit_aarch64_defconfig
```kconfig
BR2_aarch64=y
BR2_KERNEL_HEADERS_VERSION=y
BR2_DEFAULT_KERNEL_VERSION="4.1"
BR2_PACKAGE_HOST_LINUX_HEADERS_CUSTOM_4_1=y
BR2_PACKAGE_HOST_GDB=y
BR2_INIT_NONE=y
BR2_TARGET_GENERIC_GETTY_PORT="ttyAMA0"
BR2_ROOTFS_OVERLAY="$(BR2_EXTERNAL)/board/sninit/root.aarch64"
BR2_ROOTFS_POST_BUILD_SCRIPT="$(BR2_EXTERNAL)/board/sninit/post_build.sh"
BR2_ROOTFS_POST_SCRIPT_ARGS="aarch64 $(BR2_EXTERNAL)"
BR2_LINUX_KERNEL=y
BR2_LINUX_KERNEL_CUSTOM_VERSION=y
BR2_LINUX_KERNEL_CUSTOM_VERSION_VALUE="4.1"
BR2_LINUX_KERNEL_USE_CUSTOM_CONFIG=y
BR2_LINUX_KERNEL_CUSTOM_CONFIG_FILE="board/qemu/aarch64-virt/linux-4.1.config"
BR2_LINUX_KERNEL_IMAGE_TARGET_CUSTOM=y
BR2_LINUX_KERNEL_IMAGE_TARGET_NAME="Image"
BR2_PACKAGE_BUSYBOX_SHOW_OTHERS=y
BR2_PACKAGE_GDB=y
BR2_PACKAGE_DROPBEAR=y
BR2_PACKAGE_NETCAT=y
BR2_TARGET_ROOTFS_INITRAMFS=y
# BR2_TARGET_ROOTFS_TAR is not set
BR2_PACKAGE_SNINIT=y
```

## misc/buildroot/configs/sninit_arm_defconfig
```kconfig
BR2_arm=y
BR2_cortex_a9=y
BR2_ARM_ENABLE_NEON=y
BR2_ARM_FPU_VFPV3=y
BR2_PTHREAD_DEBUG=y
BR2_PACKAGE_HOST_GDB=y
BR2_INIT_NONE=y
BR2_TARGET_GENERIC_GETTY_PORT="ttyAMA0"
BR2_ROOTFS_OVERLAY="$(BR2_EXTERNAL)/board/sninit/root"
BR2_ROOTFS_POST_BUILD_SCRIPT="$(BR2_EXTERNAL)/board/sninit/post_build.sh"
BR2_ROOTFS_POST_SCRIPT_ARGS="arm $(BR2_EXTERNAL)"
BR2_LINUX_KERNEL=y
BR2_LINUX_KERNEL_SAME_AS_HEADERS=y
BR2_LINUX_KERNEL_DEFCONFIG="vexpress"
BR2_LINUX_KERNEL_ZIMAGE=y
BR2_LINUX_KERNEL_DTS_SUPPORT=y
BR2_LINUX_KERNEL_INTREE_DTS_NAME="vexpress-v2p-ca9"
BR2_PACKAGE_GDB=y
BR2_PACKAGE_DROPBEAR=y
# BR2_PACKAGE_DROPBEAR_CLIENT is not set
BR2_PACKAGE_DROPBEAR_DISABLE_REVERSEDNS=y
BR2_TARGET_ROOTFS_EXT2=y
# BR2_TARGET_ROOTFS_TAR is not set
BR2_PACKAGE_SNINIT=y
```

## misc/buildroot/configs/sninit_x86_defconfig
```kconfig
BR2_x86_nocona=y
BR2_TOOLCHAIN_BUILDROOT_GLIBC=y
BR2_PACKAGE_HOST_GDB=y
BR2_INIT_NONE=y
BR2_TARGET_GENERIC_GETTY_PORT="ttyS0"
BR2_ROOTFS_OVERLAY="$(BR2_EXTERNAL)/board/sninit/root"
BR2_ROOTFS_POST_BUILD_SCRIPT="$(BR2_EXTERNAL)/board/sninit/post_build.sh"
BR2_ROOTFS_POST_SCRIPT_ARGS="x86 $(BR2_EXTERNAL)"
BR2_LINUX_KERNEL=y
BR2_LINUX_KERNEL_CUSTOM_VERSION=y
BR2_LINUX_KERNEL_CUSTOM_VERSION_VALUE="4.1"
BR2_LINUX_KERNEL_USE_CUSTOM_CONFIG=y
BR2_LINUX_KERNEL_CUSTOM_CONFIG_FILE="board/qemu/x86/linux-4.1.config"
BR2_PACKAGE_GDB=y
BR2_PACKAGE_DROPBEAR=y
# BR2_PACKAGE_DROPBEAR_CLIENT is not set
BR2_PACKAGE_DROPBEAR_DISABLE_REVERSEDNS=y
BR2_TARGET_ROOTFS_EXT2=y
# BR2_TARGET_ROOTFS_TAR is not set
BR2_PACKAGE_SNINIT=y
```

## misc/buildroot/package/sninit/Config.in
```kconfig
config BR2_PACKAGE_SNINIT
	bool "sninit"
	depends on BR2_USE_MMU		# fork
	depends on BR2_INIT_NONE	# avoid overwriting another init
	help
	  Small init implementation based on sysvinit runlevel model
	  with support for managed daemons.

	  https://github.com/arsv/sninit

comment "sninit needs Init System: None in System Configuration"
	depends on !BR2_INIT_NONE

if BR2_PACKAGE_SNINIT

config BR2_PACKAGE_SNINIT_BUNDLED_LIBC
	bool "Use bundled libc"
	depends on BR2_i386 || BR2_arm || BR2_armeb || BR2_aarch64 || BR2_mips || BR2_mipsel || BR2_x86_64
	default y
	help
	  sninit comes with a minimalistic libc implementation
	  that provides just the necessary functions.

	  Linking against bundled libc results in smallest possible
	  static executables, but it is only available on certain platforms.

	  With this option disabled, init will be linked against whatever
	  libc has been chosen for the whole system (uClibc, musl etc).

config BR2_PACKAGE_SNINIT_DEBUG
	bool "Debug mode"
	default y
	help
	  Disable optimization and enable debugging symbols.

	  Buildroot strips target executables, but those in output/build/
	  retain their symbols. The target executable can be run under
	  gdbserver in qemu and non-stripped one can be loaded into
	  target-gdb for a remote debugging session.

config BR2_PACKAGE_SNINIT_BUILTIN_INITTAB
	string "Built-in inittab name"
	default ""
	help
	  Fallback inittab to use if /etc/inittab on the target system
	  can not be read. This is compile-time option, and the file name
	  should be relative to buildroot directory.

endif
```
